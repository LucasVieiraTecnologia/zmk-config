## boards/shields/Kconfig
```kconfig
# Kconfig for the sofle shield.
# Add definitions for symbols that are missing when building.

# Certifica que os símbolos ZMK_DISPLAY_STATUS e ZMK_ACTIVITY são definidos
config ZMK_DISPLAY_STATUS
    bool "Enable ZMK Display Status"
    depends on ZMK_DISPLAY
    default y

config ZMK_ACTIVITY
    bool "Enable ZMK Activity Monitoring"
    default y

# Define os símbolos de nível de log (como booleanos para Kconfig)
choice
    prompt "ZMK Log Level"
    # depends on ZMK_LOG_LEVEL_CHOICE # Pode precisar adicionar se der erro
    config ZMK_LOG_LEVEL_DBG
        bool "Debug"
    endchoice

config ZMK_DISPLAY_LOG_LEVEL_DBG
    bool "Debug Display Log Level"
    depends on ZMK_DISPLAY
    depends on ZMK_LOG_LEVEL_DBG
    default y

config ZMK_ACTIVITY_LOG_LEVEL_DBG
    bool "Debug Activity Log Level"
    depends on ZMK_ACTIVITY
    depends on ZMK_LOG_LEVEL_DBG
    default y

# Pode ser que você precise de um 'source "Kconfig.zephyr"' no topo se Kconfig não conseguir encontrar símbolos básicos
# source "Kconfig.zephyr"
```

## boards/shields/Kconfig.defconfig
```kconfig
# Kconfig.defconfig for sofle shield
# This file helps define default Kconfig symbols for the sofle shield.

# Ensure display status and activity are defined and enabled
config ZMK_DISPLAY_STATUS
    default y

config ZMK_ACTIVITY
    default y

# Define the log levels for display and activity
config ZMK_DISPLAY_LOG_LEVEL_DBG
    default y

config ZMK_ACTIVITY_LOG_LEVEL_DBG
    default y

# Add other display related Kconfig options here if they become undefined
# config DISPLAY_BUFFER_SIZE
#     default 512
```

## config/Kconfig
```kconfig
# Kconfig para o seu layout personalizado ZMK
source "Kconfig.zephyr"

config ZMK_DISPLAY_STATUS
    bool "Habilitar Status do Display ZMK"
    default y
    depends on ZMK_DISPLAY

config ZMK_ACTIVITY
    bool "Habilitar Monitoramento de Atividade ZMK"
    default y

choice
    prompt "Nível de Log ZMK"
    config ZMK_LOG_LEVEL_DBG
        bool "Depuração"
    endchoice

config ZMK_DISPLAY_LOG_LEVEL_DBG
    bool "Nível de Log de Depuração do Display"
    default y
    depends on ZMK_DISPLAY
    depends on ZMK_LOG_LEVEL_DBG

config ZMK_ACTIVITY_LOG_LEVEL_DBG
    bool "Nível de Log de Depuração da Atividade"
    default y
    depends on ZMK_ACTIVITY
    depends on ZMK_LOG_LEVEL_DBG

# config DISPLAY_BUFFER_SIZE
#     int "Tamanho do Buffer do Display em Bytes"
#     default 512
#     depends on ZMK_DISPLAY
```

## config/west.yml
```yaml
manifest:
  defaults:
    revision: main
  remotes:
    - name: urob
      url-base: https://github.com/urob
  projects:
    - name: zmk
      remote: urob
      revision: main
      import: app/west.yml
  self:
    path: config
```

## config/widgets/widgets/Kconfig
```kconfig
menu "User Custom Widgets"

config ZMK_WIDGET_KEY_COUNT
    bool "Enable Key Count Widget"
    depends on ZMK_DISPLAY
    help
      Enable a custom display widget that shows the number of key presses.

config ZMK_WIDGET_KEY_COUNT_LABEL
    string "Key Count Widget Label"
    depends on ZMK_WIDGET_KEY_COUNT
    default "Keys"
    help
      The label to display before the key count on the OLED.

endmenu
```

/*
 * Sofle Left overlay com OLED SSD1306
 */

&i2c1 {
    status = "okay";

    oled_left: ssd1306_left@3c {
        compatible = "solomon,ssd1306fb";
        reg = <0x3C>;
        label = "OLED_LEFT";
        height = <32>;
        width = <128>;
        segment-offset = <0>;
        page-offset = <0>;
        display-offset = <0>;
        multiplex-ratio = <31>;
    };
};

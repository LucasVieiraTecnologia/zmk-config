/*
 * Sofle Right overlay com OLED SSD1306
 */

&i2c1 {
    status = "okay";

    oled_right: ssd1306_right@3d {   /* endereço I2C diferente para não conflitar */
        compatible = "solomon,ssd1306fb";
        reg = <0x3D>;                 /* normalmente 0x3D para o segundo OLED */
        label = "OLED_RIGHT";
        height = <32>;
        width = <128>;
        segment-offset = <0>;
        page-offset = <0>;
        display-offset = <0>;
        multiplex-ratio = <31>;
    };
};

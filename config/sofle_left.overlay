// Este é o arquivo para a metade esquerda do seu teclado Sofle.
// Salve-o como sofle_left.overlay

/ {
    // Define o display OLED específico para a metade esquerda.
    chosen {
        zmk,display = &my_oled_left;
    };
}; // Fim do bloco principal '/'

&i2c0 { // Habilita o controlador I2C0, necessário para o OLED.
    status = "okay"; // Garante que o I2C0 está ativo.

    // Definição do OLED da metade esquerda.
    // 'my_oled_left' é o label que você usou acima no 'chosen'.
    my_oled_left: oled@3c {
        compatible = "solomon,ssd1306fb"; // Tipo de controlador do OLED.
        reg = <0x3c>; // Endereço I2C do seu OLED (o mais comum).
        width = <128>; // Largura do display em pixels.
        height = <32>; // Altura do display em pixels.
    }; // Fim da definição do OLED.
}; // Fim do bloco '&i2c0'.

// Definição do encoder rotativo da esquerda.
// ATENÇÃO: Verifique e ajuste os pinos GPIO (15, 16, 17) para corresponderem EXATAMENTE à sua fiação física.
left_encoder: encoder_left {
    compatible = "alps,ec11"; // Compatibilidade do tipo de encoder.
    a-gpios = <&gpio0 15 (GPIO_ACTIVE_HIGH | GPIO_PULL_UP)>; // Pino da fase A.
    b-gpios = <&gpio0 16 (GPIO_ACTIVE_HIGH | GPIO_PULL_UP)>; // Pino da fase B.
    steps = <4>; // Número de passos por rotação completa do encoder.
    status = "okay"; // Habilita o encoder.
    // Pino para o botão do encoder da esquerda (se o seu encoder tiver um botão).
    button-gpios = <&gpio0 17 (GPIO_ACTIVE_LOW | GPIO_PULL_UP)>;
}; // Fim da definição do encoder da esquerda.

// Configuração dos sensores que serão usados pelo ZMK (neste caso, o encoder).
sensors {
    compatible = "zmk,keymap-sensors";
    sensors = <&left_encoder>; // Inclui o encoder da esquerda como um sensor.
    triggers-per-rotation = <4>; // Quantos "cliques" o encoder registra por rotação completa.
}; // Fim do bloco 'sensors'.
